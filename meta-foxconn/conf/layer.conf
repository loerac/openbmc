## meta-foxconn/conf/layer.conf
```bitbake
# We have a conf and classes directory, add to BBPATH
BBPATH .= ":${LAYERDIR}"
# We have recipes-* directories, add to BBFILES
BBFILES += "${LAYERDIR}/recipes-*/*/*.bb \
            ${LAYERDIR}/recipes-*/*/*.bbappend" 
BBFILE_COLLECTIONS += "foxconn-layer" 
BBFILE_PATTERN_foxconn-layer := "^${LAYERDIR}/" 
LAYERSERIES_COMPAT_foxconn-layer = "warrior zeus"
```

## meta-foxconn/meta-tomahawk/conf/layer.conf
```bitbake
# We have a conf and classes directory, add to BBPATH
BBPATH .= ":${LAYERDIR}"

# We have recipes-* directories, add to BBFILES
BBFILES += "${LAYERDIR}/recipes-*/*/*.bb \
            ${LAYERDIR}/recipes-*/*/*.bbappend"

BBFILE_COLLECTIONS += "tomahawk"
BBFILE_PATTERN_tomahawk := "^${LAYERDIR}/"
LAYERSERIES_COMPAT_tomahawk = "warrior zeus"
```

## meta-foxconn/meta-tomahawk/conf/machine/tomahawk.conf
```bitbake
KMACHINE = "aspeed"
#Using prototype device tree
KERNEL_DEVICETREE = "${KMACHINE}-bmc-opp-${MACHINE}.dtb"
UBOOT_MACHINE = "ast_g5_ncsi_config"

#This section may need to be expanded
require conf/machine/include/ast2500.inc
require conf/machine/include/obmc-bsp-common.inc
OBMC_IMAGE_EXTRA_INSTALL_append += "ipmitool"
```
